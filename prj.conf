## CMakeLists.txt
```
cmake_minimum_required(VERSION 3.20.0)
find_package(Zephyr REQUIRED HINTS $ENV{ZEPHYR_BASE})

project(nrf9160_mqtt_simple)

# NORDIC SDK APP START

# includes
# zephyr_include_directories(.)
zephyr_include_directories(mqtt gnss datatypes pmic sensors) # can also do this with multiple calls

# sources
target_sources(app PRIVATE src/main.c
            src/datatypes/datatypes.c
            src/mqtt/mqtt_connection.c
            src/gnss/gnss.c)
# NORDIC SDK APP END
target_sources_ifdef(CONFIG_ADP536X app PRIVATE src/pmic/pmic.c)
target_sources_ifdef(CONFIG_BME680 app PRIVATE src/sensors/bme680.c)
```

## Kconfig
```
#
# Copyright (c) 2020 Nordic Semiconductor ASA
#
# SPDX-License-Identifier: LicenseRef-Nordic-5-Clause
#

menu "nRF9160 MQTT Simple"

config MQTT_PUB_TOPIC
	string "MQTT publish topic"
	default "nrf9160_mqtt_simple/publish/test_topic"

config MQTT_SUB_TOPIC
	string "MQTT subscribe topic"
	default "nrf9160_mqtt_simple/publish/test_topic"

config MQTT_CLIENT_ID
	string "MQTT Client ID"
	help
	  Use a custom Client ID string. If not set, the client ID will be
	  generated based on IMEI number (for nRF9160 based targets) or
	  randomly (for other platforms).
	default ""

config MQTT_BROKER_HOSTNAME
	string "MQTT broker hostname"
	default "test.mosquitto.org"

config MQTT_BROKER_PORT
	int "MQTT broker port"
	default 1883

config MQTT_MESSAGE_BUFFER_SIZE
	int "MQTT message buffer size"
	default 128

config MQTT_PAYLOAD_BUFFER_SIZE
	int "MQTT payload buffer size"
	default 128

config BUTTON_EVENT_PUBLISH_MSG
	string "The default message to publish on a button event"
	default "Hi from the nRF9160 SiP"

config TURN_LED_ON_CMD
	string "Command to turn on LED"
	default "LED1ON"

config TURN_LED_OFF_CMD
	string "Command to turn off LED"
	default "LED1OFF"

config MQTT_RECONNECT_DELAY_S
	int "Seconds to delay before attempting to reconnect to the broker."
	default 60

config GNSS_PERIODIC_INTERVAL
	int "Fix interval for periodic GPS fixes"
	range 10 65535
	default 120
	help
	  Fix interval (in seconds) for periodic fixes.

config GNSS_PERIODIC_TIMEOUT
	int "Fix timeout for periodic GPS fixes"
	range 0 65535
	default 480
	help
	  Fix timeout (in seconds) for periodic fixes.
	  If set to zero, GNSS is allowed to run indefinitely until a valid PVT estimate is produced.

endmenu

source "Kconfig.zephyr"
```

## prj.conf
```kconfig
# Logging
CONFIG_LOG=y
CONFIG_LOG_MODE_DEFERRED=y

# Button and LED support
CONFIG_DK_LIBRARY=y
CONFIG_SENSOR=y
# Newlib
CONFIG_NEWLIB_LIBC=y

# Networking
CONFIG_NETWORKING=y
CONFIG_NET_NATIVE=n
CONFIG_NET_SOCKETS_OFFLOAD=y
CONFIG_NET_SOCKETS=y
CONFIG_NET_SOCKETS_POSIX_NAMES=y

# Memory
CONFIG_MAIN_STACK_SIZE=4096
CONFIG_HEAP_MEM_POOL_SIZE=2048

# Modem library
CONFIG_NRF_MODEM_LIB=y

# LTE link control
CONFIG_LTE_LINK_CONTROL=y
CONFIG_LTE_NETWORK_MODE_LTE_M_NBIOT_GPS=y # all modes incl gnss

# LTE-M
CONFIG_LTE_EDRX_REQ=y # 

# MQTT
# Enable and configure the MQTT library
CONFIG_MQTT_LIB=y
CONFIG_MQTT_CLEAN_SESSION=y

# Application
# Configure the broker name, TCP port, topic names, and message
CONFIG_MQTT_PUB_TOPIC="test/topic"
CONFIG_MQTT_SUB_TOPIC="test/topic"
CONFIG_BUTTON_EVENT_PUBLISH_MSG="Hi from the nRF91 Series device"
CONFIG_MQTT_BROKER_HOSTNAME="46.218.58.86"
CONFIG_MQTT_BROKER_PORT=1883

# GNSS
# floating point for lat/long
CONFIG_NEWLIB_LIBC_FLOAT_PRINTF=y
CONFIG_FPU=y

# play with these depending on how bad your signal conditions are.
# requested periodic tau value
# Bits
# 8 7 6
# 0 0 0 – Value is incremented in multiples of 10 min
# 0 0 1 – Value is incremented in multiples of 1 h
# 0 1 0 – Value is incremented in multiples of 10 h
# 0 1 1 – Value is incremented in multiples of 2 s
# 1 0 0 – Value is incremented in multiples of 30 s
# 1 0 1 – Value is incremented in multiples of 1 min
# 1 1 0 – Value is incremented in multiples of 320 h
# 1 1 1 – Value indicates that the timer is deactivated
CONFIG_LTE_PSM_REQ_RPTAU="00101000"

# requested active time
# Bits
# 8 7 6
# 0 0 0 – Value is incremented in multiples of 2 s
# 0 0 1 – Value is incremented in multiples of 1 min
# 0 1 0 – Value is incremented in multiples of 6 min
# 1 1 1 – Value indicates that the timer is deactivated
CONFIG_LTE_PSM_REQ_RAT="00001000"
```

## boards/thingy91_nrf9160_ns.conf
```kconfig
# thingy91 is equipped with an adp536x i2c pmic. If you are on a 9160DK, you want to disable this.
CONFIG_ADP536X=y

# AQI
CONFIG_BME680=y
CONFIG_I2C=y
CONFIG_SENSOR=y
```

## src/main.c
```c
/*
 * Copyright (c) 2018 Nordic Semiconductor ASA
 *
 * SPDX-License-Identifier: LicenseRef-Nordic-5-Clause
 */

 #include <stdio.h>
 #include <ncs_version.h>
 #include <zephyr/kernel.h>
 #include <zephyr/net/socket.h>
 
 #include <zephyr/logging/log.h>
 #include <dk_buttons_and_leds.h>
 #include <modem/nrf_modem_lib.h>
 #include <modem/lte_lc.h>
 #include <zephyr/net/mqtt.h>
 
 #include "datatypes/datatypes.h"
 #include "mqtt/mqtt_connection.h"
 #include "gnss/gnss.h"
 #include "pmic/pmic.h"
 
 /* The mqtt client struct */
 static struct mqtt_client client;
 /* File descriptor */
 static struct pollfd fds;
 
 static K_SEM_DEFINE(lte_connected, 0, 1);
 
 LOG_MODULE_REGISTER(nrf9160_mqtt_gnss, LOG_LEVEL_INF);
 
 device_shadow_t g_device_state = 
 {
	 .latitude = 0,
	 .longitude = 0,
	 .altitude = 0,
	 .batt_voltage = 0,
	 .led1_state = false
 };
 
 // dont feel like using sync primitives other than lte_connected
 bool g_psm_granted = false;
 bool g_edrx_granted = false;
 bool g_started_up = false;
 
 static void lte_handler(const struct lte_lc_evt *const evt)
 {
	 switch (evt->type)
	 {
	 case LTE_LC_EVT_NW_REG_STATUS:
		 if ((evt->nw_reg_status != LTE_LC_NW_REG_REGISTERED_HOME) &&
			 (evt->nw_reg_status != LTE_LC_NW_REG_REGISTERED_ROAMING))
		 {
			 break;
		 }
		 LOG_INF("Network registration status: %s",
				 evt->nw_reg_status == LTE_LC_NW_REG_REGISTERED_HOME ? "Connected - home network" : "Connected - roaming");
		 k_sem_give(&lte_connected);
		 break;
 
	 case LTE_LC_EVT_RRC_UPDATE:
		 LOG_INF("RRC mode: %s", evt->rrc_mode == LTE_LC_RRC_MODE_CONNECTED ? "Connected" : "Idle");
		 break;
 
	 /* On event PSM update, print PSM paramters and check if was enabled */
	 case LTE_LC_EVT_PSM_UPDATE:
		 LOG_INF("PSM parameter update: Periodic TAU: %d s, Active time: %d s",
				 evt->psm_cfg.tau, evt->psm_cfg.active_time);
		 if (evt->psm_cfg.active_time == -1)
		 {
			 LOG_ERR("Network rejected PSM parameters. Failed to enable PSM");
		 }
		 else
		 {
			 g_psm_granted = true;
		 }
		 break;
	 /* On event eDRX update, print eDRX paramters */
	 case LTE_LC_EVT_EDRX_UPDATE:
		 g_edrx_granted = true;
		 LOG_INF("eDRX parameter update: eDRX: %f, PTW: %f",
				 (double)evt->edrx_cfg.edrx, (double)evt->edrx_cfg.ptw);
		 break;
	 default:
		 break;
	 }
 }
 
 static int modem_configure(void)
 {
	 int err;
 
	 LOG_INF("Initializing modem library");
	 err = nrf_modem_lib_init();
	 if (err)
	 {
		 LOG_ERR("Failed to initialize the modem library, error: %d", err);
		 return err;
	 }
 
 /* lte_lc_init deprecated in >= v2.6.0 */
 #if NCS_VERSION_NUMBER < 0x20600
	 err = lte_lc_init();
	 if (err)
	 {
		 LOG_ERR("Failed to initialize LTE link control library, error: %d", err);
		 return err;
	 }
 #endif
 
	 /* Request PSM and eDRX from the network */
	 err = lte_lc_psm_req(true);
	 if (err)
	 {
		 LOG_ERR("lte_lc_psm_req, error: %d", err);
	 }
 
	 err = lte_lc_edrx_req(true);
	 if (err)
	 {
		 LOG_ERR("lte_lc_edrx_req, error: %d", err);
	 }
 
	 LOG_INF("Connecting to LTE network");
	 err = lte_lc_connect_async(lte_handler);
	 if (err)
	 {
		 LOG_ERR("Error in lte_lc_connect_async, error: %d", err);
		 return err;
	 }
 
	 k_sem_take(&lte_connected, K_FOREVER);
	 LOG_INF("Connected to LTE network");
	 dk_set_led_on(DK_LED2);
 
	 return 0;
 }
 
  void periodic_publish_thread(void)
 {
	 int err;
	 int json_len;
	 bool stock_message = false;
 
	 uint8_t json_payload[DEVICE_MSG_LEN];
 
	 while (1)
	 {
		 stock_message = false;
 
		 json_len = device_to_json(json_payload, DEVICE_MSG_LEN, g_device_state);
		 if (json_len >= DEVICE_MSG_LEN || json_len < 0)
		 {
			 stock_message = true;
			 LOG_ERR("Failure in json packet creation");
			 LOG_ERR("Tried to make len %d msg %s", json_len, json_payload);
		 }
 
		 if (stock_message)
		 {
			 err = data_publish(&client, MQTT_QOS_1_AT_LEAST_ONCE,
								CONFIG_BUTTON_EVENT_PUBLISH_MSG,
								sizeof(CONFIG_BUTTON_EVENT_PUBLISH_MSG) - 1);
			 if (err)
			 {
				 LOG_INF("Failed to send message, %d", err);
			 }
		 }
		 else
		 {
			 err = data_publish(&client, MQTT_QOS_1_AT_LEAST_ONCE,
								json_payload, json_len);
			 if (err)
			 {
				 LOG_INF("Failed to send JSON message, %d", err);
			 }
		 }
 
		 k_sleep(K_SECONDS(30)); // 🕒 attendre 30 secondes
	 }
 }
 
 
 static int mqtt_try_connect(void)
 {
	 int err;
	 uint32_t connect_attempt = 0;
 
	 while (1)
	 {
		 if (connect_attempt++ > 0)
		 {
			 LOG_INF("Reconnecting in %d seconds...",
					 CONFIG_MQTT_RECONNECT_DELAY_S);
			 k_sleep(K_SECONDS(CONFIG_MQTT_RECONNECT_DELAY_S));
		 }
		 LOG_INF("Connection to broker using mqtt_connect");
		 err = mqtt_connect(&client);
		 if (err)
		 {
			 LOG_ERR("Error in mqtt_connect: %d, retrying...", err);
		 }
		 else
		 {
			 break;
		 }
	 }
	 err = fds_init(&client, &fds);
	 if (err)
	 {
		 LOG_ERR("Error in fds_init: %d", err);
		 return 0;
	 }
	 return 0;
 }
 
 static int mqtt_connection(void)
 {
	 int err;
	 err = poll(&fds, 1, mqtt_keepalive_time_left(&client));
	 if (err < 0)
	 {
		 LOG_ERR("Error in poll(): %d", errno);
		 return -1;
	 }
 
	 err = mqtt_live(&client);
	 if ((err != 0) && (err != -EAGAIN))
	 {
		 LOG_ERR("Error in mqtt_live: %d", err);
		 return -2;
	 }
 
	 if ((fds.revents & POLLIN) == POLLIN)
	 {
		 err = mqtt_input(&client);
		 if (err != 0)
		 {
			 LOG_ERR("Error in mqtt_input: %d", err);
			 return -3;
		 }
	 }
 
	 if ((fds.revents & POLLERR) == POLLERR)
	 {
		 LOG_ERR("POLLERR");
		 return -4;
	 }
 
	 if ((fds.revents & POLLNVAL) == POLLNVAL)
	 {
		 LOG_ERR("POLLNVAL");
		 return -5;
	 }
 
	 // success
	 return 0;
 }
 
 
	 // 🧵 Lancer le thread périodique
	 // (cette ligne peut être mise ici, ou dans le bloc global avant main())
	 K_THREAD_DEFINE(publish_thread_id, 2048,
		 periodic_publish_thread, NULL, NULL, NULL,
		 5, 0, 0);
 
 int main(void)
 {
	 int err;
 
	 if (dk_leds_init() != 0)
	 {
		 LOG_ERR("Failed to initialize the LED library");
	 }
 
	 err = modem_configure();
	 if (err)
	 {
		 LOG_ERR("Failed to configure the modem");
		 return 0;
	 }
 
	 // ❌ Supprimé : plus besoin des boutons
	 // if (dk_buttons_init(button_handler) != 0)
	 // {
	 // 	LOG_ERR("Failed to initialize the buttons library");
	 // }
 
	 
 
	 err = client_init(&client);
	 if (err)
	 {
		 LOG_ERR("Failed to initialize MQTT client: %d", err);
		 return 0;
	 }
 
	 mqtt_try_connect();
 
	 LOG_DBG("PSM: %d EDRX %d", g_psm_granted, g_edrx_granted);
	 err = gnss_init_and_start();
	 if (err != 0)
	 {
		 LOG_ERR("Failed to initialize and start GNSS");
		 return 0;
	 }
 
 
	 int mqtt_err = 0; // >=0 success
	 while (1)		  // main application loop
	 {
		 while (mqtt_err >= 0) // connection loop
		 {
			 mqtt_err = mqtt_connection();
		 }
		 // disconnect then reconnect.
		 if (mqtt_err < 0)
		 {
			 mqtt_err = 0; // reset flag
			 LOG_INF("Disconnecting MQTT client");
 
			 err = mqtt_disconnect(&client);
			 if (err)
			 {
				 LOG_ERR("Could not disconnect MQTT client: %d", err);
			 }
			 mqtt_try_connect(); // reconnect
		 }
	 }
 
	 return 0;
 }
 
```

## src/bme680.c
```c
#include <stdio.h>
#include <zephyr/kernel.h>
#include <zephyr/device.h>
#include <zephyr/drivers/sensor.h>
#include <drivers/bme68x_iaq.h>
#include "bme680.h"
#include "../datatypes/datatypes.h"
#include <zephyr/logging/log.h>

extern device_shadow_t g_device_state;
LOG_MODULE_REGISTER(bme680_module, LOG_LEVEL_INF);

int aqi_thread(void)
{
    const struct device *const dev = DEVICE_DT_GET_ONE(bosch_bme680);
    struct sensor_value temp, press, humidity, gas_res;

    if (!device_is_ready(dev))
    {
        printk("sensor: device not ready.\n");
        return 0;
    }

    while (1)
    {
        sensor_sample_fetch(dev);
        sensor_channel_get(dev, SENSOR_CHAN_AMBIENT_TEMP, &temp);
        
        // Ajout spécifique pour l'affichage température
        LOG_INF("[TEMPERATURE] %.2f C", sensor_value_to_double(&temp));  // Nouvelle ligne
        
        sensor_channel_get(dev, SENSOR_CHAN_PRESS, &press);
        sensor_channel_get(dev, SENSOR_CHAN_HUMIDITY, &humidity);
        sensor_channel_get(dev, SENSOR_CHAN_GAS_RES, &gas_res);

        LOG_INF("T: %d.%02d C; P: %d.%02d kPa; H: %d.%02d %% humid; G: %d.%02d ohms",
                temp.val1, temp.val2, press.val1, press.val2,
                humidity.val1, humidity.val2, gas_res.val1,
                gas_res.val2);

        g_device_state.temperature = temp.val1;
        g_device_state.pressure = press.val1;
        g_device_state.relative_humidity = humidity.val1;
        g_device_state.gas_res = gas_res.val1;

        k_sleep(K_MSEC(SENSOR_SAMPLE_INTERVAL_MS));
    }
    return 0;
}

K_THREAD_DEFINE(aqi_thread_id, STACKSIZE, aqi_thread, NULL, NULL, NULL, AQI_THREAD_PRIORITY, 0, 0);
```

## src/bme680.h
```c
#ifndef _BME680_H_
#define _BME680_H

#define STACKSIZE 1024
#define AQI_THREAD_PRIORITY 8
#define SENSOR_SAMPLE_INTERVAL_MS 20000

#endif /* _BME680_H_ */
```
